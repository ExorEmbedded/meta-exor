## conf/bblayers.conf.sample
```bitbake
# POKY_BBLAYERS_CONF_VERSION is increased each time build/conf/bblayers.conf
# changes incompatibly
POKY_BBLAYERS_CONF_VERSION = "2"

BBPATH = "${TOPDIR}"
SRCDIR = "${TOPDIR}/../git"

BBFILES ?= ""

BBLAYERS ?= " \
  ${SRCDIR}/meta-exor \
  ${SRCDIR}/meta-freescale \
  ${SRCDIR}/poky/meta \
  ${SRCDIR}/poky/meta-poky \
  ${SRCDIR}/poky/meta-yocto-bsp \
  ${SRCDIR}/meta-openembedded/meta-oe \
"
```

## conf/distro/exorintos.conf
```bitbake
require conf/distro/poky.conf

DISTRO = "exorintos"

DISTRO_NAME = "ExorintOS"

# Kirkstone Based
DISTRO_VERSION = "6.0"

DISTRO_CODENAME = "exorintos"

DISTRO_FEATURES:append = " pam wayland"
DISTRO_FEATURES:remove = "x11"
```

## conf/layer.conf
```bitbake
# We have a conf and classes directory, append to BBPATH
BBPATH .= ":${LAYERDIR}"

# We have a recipes directory, add to BBFILES
BBFILES += "${LAYERDIR}/recipes*/*/*.bb ${LAYERDIR}/recipes*/*/*.bbappend"

BBFILE_COLLECTIONS += "exor"
BBFILE_PATTERN_exor := "^${LAYERDIR}/"
BBFILE_PRIORITY_exor = "9"

LAYERSERIES_COMPAT_exor = "kirkstone"
```

## conf/machine/exor.inc
```bitbake
IMAGE_FSTYPES = "tar.gz"
IMAGE_NAME_SUFFIX = ""

MKUBIFS_ARGS = "-F -m 2048 -e 126976 -c 4095"
UBINIZE_ARGS = "-m 2048 -p 128KiB -s 512 -O 2048"
UBI_VOLNAME = "rootfs"

MACHINE_EXTRA_RRECOMMENDS += "kernel-devicetree kernel-modules"

MACHINE_FEATURES = "serial rtc"
```

## conf/machine/ns01-ek435.conf
```bitbake
#@TYPE: Machine
#@NAME: Exor nSOM01
#@DESCRIPTION: Machine configuration for the Exor nSOM01
require exor.inc

SOC_FAMILY = "mx6:mx6ul"

# Make sure hard fp is enabled (-mfloat-abi=hard GCC option)
DEFAULTTUNE = "cortexa7hf-neon"

SERIAL_CONSOLE = "115200 ttymxc0"


MACHINEOVERRIDES =. "nsom01:mx6:mx6ul:"
require conf/machine/include/imx-base.inc
require conf/machine/include/tune-cortexa7.inc

PREFERRED_PROVIDER_virtual/kernel = "linux-fslc-mx6-rt"
PREFERRED_VERSION_linux-fslc-mx6-rt = "4.1-2.0.x"

PREFERRED_PROVIDER_virtual/bootloader = "bootloader"
UBOOT_MACHINE = "ns01-imx6ul_config"

KERNEL_DEVICETREE = "ns01-ek435.dtb"
KERNEL_MACHINE = "imx6nsom"
```

## conf/machine/ns01-keb01.conf
```bitbake
#@TYPE: Machine
#@NAME: Exor nSOM01
#@DESCRIPTION: Machine configuration for the Exor Keb01-nSOM01

require conf/machine/include/imx-base.inc
require conf/machine/include/tune-cortexa7.inc
require conf/machine/include/soc-family.inc
require exor.inc

SOC_FAMILY = "mx6:mx6ul"

MACHINEOVERRIDES_EXTENDER_mx6ul = ""

SERIAL_DEV = "ttymxc"
SERIAL_CONSOLE = "115200 ${SERIAL_DEV}0"

PREFERRED_PROVIDER_virtual/kernel = "linux-fslc-mx6-rt"
PREFERRED_VERSION_linux-fslc-mx6-rt = "4.1-2.0.x"

PREFERRED_PROVIDER_virtual/bootloader = "bootloader"
UBOOT_MACHINE = "ns01-imx6ul_config"

ACCEPT_FSL_EULA = "1"

KERNEL_MACHINE = "imx6nsom"
KERNEL_DEVICETREE = "ns01-keb01.dtb"

MACHINEOVERRIDES =. "nsom01:keb01:"
```

## conf/machine/ns01-kit.conf
```bitbake
#@TYPE: Machine
#@NAME: Exor nSOM01
#@DESCRIPTION: Machine configuration for the Exor nSOM01

require conf/machine/include/imx-base.inc
require conf/machine/include/tune-cortexa7.inc
require conf/machine/include/soc-family.inc
require exor.inc

SOC_FAMILY = "mx6:mx6ul"

MACHINEOVERRIDES_EXTENDER_mx6ul = ""

SERIAL_DEV = "ttymxc"
SERIAL_CONSOLE = "115200 ${SERIAL_DEV}0"

PREFERRED_PROVIDER_virtual/kernel = "linux-fslc-mx6"
PREFERRED_VERSION_linux-fslc-mx6-rt = "4.9-2.3.x"

PREFERRED_PROVIDER_virtual/bootloader = "bootloader"
UBOOT_MACHINE = "ns01-imx6ul_config"

ACCEPT_FSL_EULA = "1"

KERNEL_MACHINE = "imx6nsom"
KERNEL_DEVICETREE = "ns01-evk.dtb ns01-ek435.dtb"

MACHINEOVERRIDES =. "nsom01:"
```

## conf/machine/ns02-kit.conf
```bitbake
#@TYPE: Machine
#@NAME: Exor nSOM02
#@DESCRIPTION: Machine configuration for Exor nSOM02

require conf/machine/include/tune-cortexa7.inc
require exor.inc

# Make sure hard fp is enabled (-mfloat-abi=hard GCC option)
DEFAULTTUNE = "cortexa7hf-neon"

SERIAL_DEV = "ttySTM"
SERIAL_CONSOLE = "115200 ${SERIAL_DEV}0"

PREFERRED_PROVIDER_virtual/kernel = "linux-stm"
PREFERRED_VERSION_linux-fslc-mx6-rt = "4.19%"

PREFERRED_PROVIDER_virtual/bootloader = "bootloader"
UBOOT_MACHINE = "stm32mp15_ns02_defconfig"

KERNEL_MACHINE = "ns02"
KERNEL_DEVICETREE = "ns02_ek435.dtb"

MACHINEOVERRIDES =. "nsom02:"
```

## conf/machine/us01-hs07.conf
```bitbake
#@TYPE: Machine
#@NAME: Exor uSOM01 HSXX
#@DESCRIPTION: Machine configuration for the Exor uSOM01 based board

require exor.inc
require conf/machine/include/tune-cortexa8.inc

# Make sure hard fp is enabled (-mfloat-abi=hard GCC option)
DEFAULTTUNE = "cortexa8hf-neon"

SERIAL_DEV = "ttyO"
SERIAL_CONSOLE = "115200 ${SERIAL_DEV}0"

PREFERRED_PROVIDER_virtual/kernel = "linux"
PREFERRED_VERSION_linux-ti-staging = "3.12%"

UBOOT_MACHINE = "am335x_usom_config"
KERNEL_MACHINE = "am33xxusom"

MACHINEOVERRIDES =. "usom01:"
```

## conf/machine/us01-kit.conf
```bitbake
#@TYPE: Machine
#@NAME: Exor uSOM
#@DESCRIPTION: Machine configuration for the Exor uSOM01

require conf/machine/include/tune-cortexa8.inc
require exor.inc

SOC_FAMILY = "ti33x"
require conf/machine/include/soc-family.inc

# Make sure hard fp is enabled (-mfloat-abi=hard GCC option)
DEFAULTTUNE = "cortexa8hf-neon"

SERIAL_DEV = "ttyO"
SERIAL_CONSOLE = "115200 ${SERIAL_DEV}0"

PREFERRED_PROVIDER_virtual/kernel = "linux-ti-staging"
PREFERRED_VERSION_linux-ti-staging = "4.1%"

UBOOT_MACHINE = "am335x_usom_config"
KERNEL_DEVICETREE = "usom_eco.dtb"

# Uncomment these lines to enable hardware acceleration on a wayland image
#PREFERRED_PROVIDER_virtual/egl = "ti-sgx-ddk-um"
#PREFERRED_PROVIDER_virtual/libgles1 = "ti-sgx-ddk-um"
#PREFERRED_PROVIDER_virtual/libgles2 = "ti-sgx-ddk-um"
#PREFERRED_PROVIDER_virtual/libgl = "mesa-gl"
#PREFERRED_PROVIDER_virtual/mesa = "mesa-gl"
#PREFERRED_PROVIDER_libgbm = "libgbm"

# List common SoC features, may need to add touchscreen for specific machines
MACHINE_FEATURES = "vfat touchscreen ethernet sgx"

MACHINEOVERRIDES =. "usom01:"
```

## conf/machine/us02-kit.conf
```bitbake
#@TYPE: Machine
#@NAME: Exor uSOM
#@DESCRIPTION: Machine configuration for the Exor uSOM02

require conf/machine/include/tune-cortexa9.inc
require exor.inc

# Make sure hard fp is enabled (-mfloat-abi=hard GCC option)
DEFAULTTUNE = "cortexa9hf-neon"

SERIAL_DEV = "ttyS"
SERIAL_CONSOLE = "115200 ${SERIAL_DEV}0"

PREFERRED_PROVIDER_virtual/kernel = "linux-altera"

UBOOT_MACHINE = "socfpga_cyclone5_config"
KERNEL_MACHINE = "socfpga"
KERNEL_DEVICETREE = "usom_us02kit.dtb"

MACHINEOVERRIDES =. "usom02:"
```

## conf/machine/us03-kit.conf
```bitbake
#@TYPE: Machine
#@NAME: Exor uSOM
#@DESCRIPTION: Machine configuration for the Exor uSOM03

MACHINEOVERRIDES =. "usom03:mx6:mx6q:mx6dl:"

require conf/machine/include/imx-base.inc
require conf/machine/include/tune-cortexa9.inc
require exor.inc

SERIAL_DEV = "ttymxc"
SERIAL_CONSOLE = "115200 ${SERIAL_DEV}0"

PREFERRED_PROVIDER_virtual/bootloader = "bootloader"
UBOOT_MACHINE = "mx6q_usom_config"

PREFERRED_PROVIDER_virtual/kernel = "linux-fslc-imx"

ACCEPT_FSL_EULA = "1"
MACHINE_USES_VIVANTE_KERNEL_DRIVER_MODULE = "0"

KERNEL_MACHINE = "imx6usom"
KERNEL_DEVICETREE = "usom_evkitq.dtb usom_etop7xxq.dtb"
```

## conf/machine/us04-kit.conf
```bitbake
#@TYPE: Machine
#@NAME: Exor uSOM04 JSXX
#@DESCRIPTION: Machine configuration for Exor uSOM04 based custom

MACHINEOVERRIDES =. "exor:hsxx:usom04:mx8:mx8m:mx8mm:"

require conf/machine/include/imx-base.inc
require conf/machine/include/arm/armv8a/tune-cortexa53.inc
require exor.inc

SPL_BINARY = "spl/u-boot-spl.bin"
UBOOT_CONFIG ??= "sd"
UBOOT_CONFIG[sd] = "imx8mm_us04_defconfig,sdcard"
UBOOT_DTB_NAME = "imx8mm_us04.dtb"

# Set DDR FIRMWARE
DDR_FIRMWARE_NAME = "\
lpddr4_pmu_train_1d_imem.bin \
lpddr4_pmu_train_1d_dmem.bin \
lpddr4_pmu_train_2d_imem.bin \
lpddr4_pmu_train_2d_dmem.bin \
"

# Set imx-mkimage boot target
IMXBOOT_TARGETS = "flash_evk"

# Set Serial console
SERIAL_CONSOLE = "115200 ttymxc1"

IMAGE_BOOTLOADER = "imx-boot"
IMX_BOOT_SOC_TARGET = "iMX8MM"

BOOT_SPACE = "65536"

LOADADDR = ""
UBOOT_SUFFIX = "bin"
UBOOT_MAKE_TARGET ?= ""
IMX_BOOT_SEEK = "33"

OPTEE_BIN_EXT = "8mm"

SERIAL_DEV = "ttymxc"

SERIAL_CONSOLE = "115200 ${SERIAL_DEV}1"

PREFERRED_PROVIDER_u-boot ?= "bootloader-imx8mm"
PREFERRED_PROVIDER_virtual/bootloader = "bootloader-imx8mm"
PREFERRED_VERSION:imx-atf = "2.0"
PREFERRED_VERSION:firmware-imx-8m = "8.5"

PREFERRED_PROVIDER_virtual/kernel = "linux-imx-rt"
PREFERRED_VERSION_virtual/kernel = "4.14%"

PREFERRED_VERSION_gstreamer1.0 = "${@bb.utils.contains("DISTRO_FEATURES", "wayland", "1.16.2.imx", "",d)}"
PREFERRED_VERSION_gstreamer1.0-plugins-base = "${@bb.utils.contains("DISTRO_FEATURES", "wayland", "1.16.2.imx", "",d)}"
PREFERRED_VERSION_gstreamer1.0-plugins-good = "${@bb.utils.contains("DISTRO_FEATURES", "wayland", "1.16.3.imx", "",d)}"
PREFERRED_VERSION_gstreamer1.0-plugins-bad = "${@bb.utils.contains("DISTRO_FEATURES", "wayland", "1.16.3.imx", "",d)}"

ACCEPT_FSL_EULA = "1"

IMX_DEFAULT_BSP = "nxp"
MACHINE_HAS_VIVANTE_KERNEL_DRIVER_SUPPORT = "1"

SOC_DEFAULT_IMAGE_FSTYPES = "tar.gz"

KERNEL_MACHINE = "us04"
KERNEL_IMAGETYPE = "Image"

ATF_PLATFORM = "imx8mm"

KERNEL_DEVICETREE = "freescale/us04_etopxx.dtb"
```

## conf/machine/us05-kit.conf
```bitbake
#@TYPE: Machine
#@NAME: Exor uSOM
#@DESCRIPTION: Machine configuration for the Exor uSOM02

require conf/machine/include/tune-cortexa9.inc
require exor.inc

# Make sure hard fp is enabled (-mfloat-abi=hard GCC option)
DEFAULTTUNE = "cortexa9hf-neon"

SERIAL_DEV = "ttyS"
SERIAL_CONSOLE = "115200 ${SERIAL_DEV}0"

PREFERRED_PROVIDER_virtual/kernel = "linux-altera"

UBOOT_MACHINE = "us05_evk_config"
KERNEL_MACHINE = "socfpgausom_us05kit"
KERNEL_DEVICETREE = "usom_us05kit.dtb usom_us05kit-4mac.dtb"

MACHINEOVERRIDES =. "usom05:"
```
